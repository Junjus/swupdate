## configs/debian_defconfig
```kconfig
CONFIG_SYSTEMD=y
CONFIG_HW_COMPATIBILITY=y
CONFIG_DOWNLOAD=y
CONFIG_DOWNLOAD_SSL=y
CONFIG_SIGNED_IMAGES=y
CONFIG_SIGALG_CMS=y
CONFIG_ENCRYPTED_IMAGES=y
CONFIG_SURICATTA=y
CONFIG_SURICATTA_SSL=y
CONFIG_UPDATE_STATE_CHOICE_BOOTLOADER=y
CONFIG_WEBSERVER=y
CONFIG_MONGOOSESSL=y
CONFIG_ZSTD=y
CONFIG_DISKPART=y
CONFIG_RAW=y
CONFIG_RDIFFHANDLER=y
CONFIG_READBACKHANDLER=y
CONFIG_SHELLSCRIPTHANDLER=y
CONFIG_ARCHIVE=y
CONFIG_BOOTLOADERHANDLER=y
CONFIG_SWUFORWARDER_HANDLER=y
CONFIG_CFI=y
CONFIG_CFIHAMMING1=y
CONFIG_UBIVOL=y
CONFIG_SSBLSWITCH=y
CONFIG_BOOTLOADER_NONE=y
CONFIG_LUAPKG="lua5.2"
CONFIG_LUASCRIPTHANDLER=y
CONFIG_HANDLER_IN_LUA=y
CONFIG_EXTRA_CFLAGS="-g -O2 -ffile-prefix-map=/home/junus/git/junjus_swupdate=. -fstack-protector-strong -Wformat -Werror=format-security -Wall -pedantic -I/usr/include/p11-kit-1 -Wdate-time -D_FORTIFY_SOURCE=2"
CONFIG_EXTRA_LDFLAGS="-Wl,-z,relro -Wl,-z,now"
CONFIG_EXTRA_LDLIBS=""
```

## debian/configs/defconfig
```kconfig
CONFIG_SYSTEMD=y
CONFIG_BOOTLOADER_GRUB=y
CONFIG_GRUBENV_PATH="/boot/grub/grubenv"
CONFIG_BOOTLOADER_DEFAULT_NONE=y
CONFIG_DOWNLOAD=y
CONFIG_DOWNLOAD_SSL=y
CONFIG_SIGALG_CMS=y
CONFIG_CMS_SKIP_UNKNOWN_SIGNERS=y
CONFIG_ENCRYPTED_IMAGES=y
CONFIG_SURICATTA=y
CONFIG_SURICATTA_SSL=y
CONFIG_UPDATE_STATE_CHOICE_BOOTLOADER=y
CONFIG_WEBSERVER=y
CONFIG_MONGOOSESSL=y
CONFIG_ZSTD=y
CONFIG_DISKPART=y
CONFIG_DISKPART_FORMAT=y
CONFIG_DISKFORMAT=y
CONFIG_DISKFORMAT_HANDLER=y
CONFIG_FAT_FILESYSTEM=y
CONFIG_EXT_FILESYSTEM=y
CONFIG_UNIQUEUUID=y
CONFIG_RAW=y
CONFIG_RDIFFHANDLER=y
CONFIG_READBACKHANDLER=y
CONFIG_SHELLSCRIPTHANDLER=y
CONFIG_ARCHIVE=y
CONFIG_BOOTLOADERHANDLER=y
CONFIG_HASH_VERIFY=y
CONFIG_DELTA=y
```
